## Kconfig
```kconfig
mainmenu "Global Configuration List"

menu "General setup"

config HOST_CPU
	string "Machine Hardware Name"
	default "x86_64"
	help
	  Confirm the machine hardware name with command "uname -m"
	  (eg: x86_64/aarch64...)

config HOST_VENDOR
	string "Machine Vendor Name"
	default "none"

config HOST_OS
	string "Machine Operation System"
	default "linux-gnu"

config CROSS_COMPILE
	string "Cross Compile"

endmenu

source "common/Kconfig"
source "tools/Kconfig"
```

## legacy/tools/usb/Kconfig
```kconfig
config LIBUSB
	bool "Library for USB Device"
	default y

config LIBUSB_VERSION
	string "LIBUSB Version"
	depends on LIBUSB
	default "libusb-1.0.26"
	help
	  LIBUSB version support: libusb-1.0.24, libusb-1.0.26

config LIBUVC
	bool "Library for USB Video Device"

config LIBUVC_VERSION
	string "LIBUVC Version"
	depends on LIBUVC
	default "libuvc-0.0.6"
	help
	  LIBUVC version support: libuvc-0.0.6
```
